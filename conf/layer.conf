## conf/layer.conf
```bitbake
# We have a conf and classes directory, add to BBPATH
BBPATH .= ":${LAYERDIR}"

# We have recipes-* directories, add to BBFILES
BBFILES += "${LAYERDIR}/recipes-wsl2/*/*.bb \
            ${LAYERDIR}/recipes-wsl2/*/*.bbappend"

BBFILES_DYNAMIC += "\
    meta-luneos:${LAYERDIR}/recipes-luneos/*/*.bbappend \
    meta-webos:${LAYERDIR}/recipes-webos-ose/*/*.bbappend \
"

BBFILE_COLLECTIONS += "meta-wsl2"
BBFILE_PATTERN_meta-wsl2 = "^${LAYERDIR}/"
# priority override luneos qtwayland_git.bbappend > 20
# priority override webos several packages > 40
BBFILE_PRIORITY_meta-wsl2 = "41"

LAYERDEPENDS_meta-wsl2 = "core"
LAYERSERIES_COMPAT_meta-wsl2 = "nanbield scarthgap kirkstone"

# TODO: remove ERROR_QA:remove when sam patches are adjusted, this prevents patch fuzz errors
ERROR_QA:remove = "patch-fuzz"
IMAGE_FSTYPES:append = " tar.gz"

RDEPENDS:packagegroup-luneos-extended:remove = "waydroid"
```

## conf/machine/qemuwslx86.conf
```bitbake
require conf/machine/qemux86.conf

# PREFERRED_PROVIDER_virtual/kernel = "linux-dummy"
# IMAGE_FSTYPES = ".tar.gz"
VOLATILE_LOG_DIR = "no"
IMAGE_INSTALL:append = " ld.so.conf.d wsl.conf"
hostname:pn-base-files = "wsl-x86"
DEPLOY_DIR_IMAGE = "${DEPLOY_DIR}/images/wsl-x86"
MACHINE = "qemux86"
```

## conf/machine/wsl-x86-64.conf
```bitbake
require conf/machine/qemux86-64.conf

# PREFERRED_PROVIDER_virtual/kernel = "linux-dummy"
# IMAGE_FSTYPES = ".tar.gz"
VOLATILE_LOG_DIR = "no"
IMAGE_INSTALL:append = " ld.so.conf.d wsl.conf"
hostname:pn-base-files = "wsl-x86-64"
DEPLOY_DIR_IMAGE = "${DEPLOY_DIR}/images/wsl-x86-64"
MACHINE = "qemux86-64"
```

## conf/machine/wslx86-64.conf
```bitbake
require conf/machine/qemux86-64.conf

# PREFERRED_PROVIDER_virtual/kernel = "linux-dummy"
# IMAGE_FSTYPES = ".tar.gz"
VOLATILE_LOG_DIR = "no"
IMAGE_INSTALL:append = " ld.so.conf.d wsl.conf"
```
